## config/boards/shields/slate/Kconfig.shield
```kconfig
# Copyright (c) 2020 The ZMK Contributors
# SPDX-License-Identifier: MIT

config SHIELD_AFO_LEFT
	def_bool $(shields_list_contains,afo_left)

config SHIELD_AFO_RIGHT
	def_bool $(shields_list_contains,afo_right)
  
```
